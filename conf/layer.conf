## conf/layer.conf
```bitbake
# We have a conf and classes directory, add to BBPATH
BBPATH .= ":${LAYERDIR}"

# We have recipes-* directories, add to BBFILES
BBFILES += "${LAYERDIR}/recipes-*/*/*.bb \
	${LAYERDIR}/recipes-*/*/*.bbappend"

BBFILE_COLLECTIONS += "heipc-layer"
BBFILE_PATTERN_heipc-layer = "^${LAYERDIR}/"
BBFILE_PRIORITY_heipc-layer = "10"

# This should only be incremented on significant changes that will
# cause compatibility issues with other layers
LAYERVERSION_heipc-layer = "1"

#LAYERDEPENDS_heipc = "core" #?

LAYERSERIES_COMPAT_heipc-layer = "scarthgap"
```
